## CMakeLists.txt
```
# SPDX-License-Identifier: Apache-2.0

cmake_minimum_required(VERSION 3.13.1)
include($ENV{ZEPHYR_BASE}/cmake/app/boilerplate.cmake NO_POLICY_SCOPE)
project(hermes)

include_directories(include src/ src/lib/)
FILE(GLOB_RECURSE app_sources include/*.cpp include/*.c src/*.cpp src/*.c)
target_sources(app PRIVATE ${app_sources} src/main.cpp)
```

## src/main.cpp
```c
#include <zephyr.h>
#include <sys/util.h>
#include <inttypes.h>
#include <time.h>
extern "C" {
#include "lib/log.h"
#include "hw/storage.h"
#include "hw/clock.h"
#include "hw/backlight.h"
#include "hw/display.h"
#include "hw/button.h"
#include "hw/battery.h"
#include "hw/bt.h"
#include "service/msg_store.h"
#include "service/powersave.h"
#include "service/cts.h"
#include "service/cts_sync.h"
#include "service/bt_notify_service.h"
}
#include "ui/win.h"
#include "ui/win/home.h"
#include "ui/win/console.h" // TESTING

void delay(int ms) {
	k_sleep(K_MSEC(ms));
}

void setup(void) {	

    settings_subsys_init();
	// HW
	LOG_INF("App setup: hardware");
	//storage_init();
	clock_init();
	backlight_init();
	button_init();
	display_init();
	battery_init();	
	bt_setup();

	// Services
	LOG_INF("App setup: services");
	msg_store_init();
	powersave_init();
	cts_init();
	cts_sync_init();
	bt_notify_service_init();

	win_init();

	win_activate(win_home_get());
	// TESTING:
	win_activate(win_console_get());

	LOG_INF("App setup complete.");
}

inline void loop() {
	delay(990);

	// HW
	//storage_loop();
	clock_loop();
	battery_loop();
	bt_loop();

	// Services
	msg_store_loop();
	powersave_loop();
	cts_loop();
	cts_sync_loop();
	bt_notify_service_loop();

	win_loop();
}

void main(void)
{
	LOG_INF("PineTime Hermes starting.");

	setup();

	while (1) {
		loop();
	}
}
```

## include/common.h
```c
#include <stdlib.h>
#include <stdio.h>
#include <kernel.h>
#include <string.h>
#include <ctype.h>

#define boolean bool

char* itoa(int value, char* buffer, int base);
char* utoa(unsigned int val, char * s, int radix);
char* ultoa(unsigned long val, char * s, int radix);
char* ltoa(long val, char * s, int radix);

char *dtostrf(double val, signed char width, unsigned char prec, char *sout);

#ifndef MIN
#define MIN(X,Y) ((X) < (Y) ? : (X) : (Y))
#endif
#ifndef MAX
#define MAX(X,Y) ((X) > (Y) ? : (X) : (Y))
#endif
```

## src/GFX.h
```c
#include <zephyr.h>
#include <device.h>
#include <display.h>

#define ST77XX_BLACK 0x0000
#define ST77XX_WHITE 0xFFFF
#define ST77XX_RED 0xF800
#define ST77XX_GREEN 0x07E0
#define ST77XX_BLUE 0x001F
#define ST77XX_CYAN 0x07FF
#define ST77XX_MAGENTA 0xF81F
#define ST77XX_YELLOW 0xFFE0
#define ST77XX_ORANGE 0xFC00

#include "Adafruit-GFX-Library/Adafruit_GFX.h"

/**
 * Implementation of Adafruit_GFX graphics library for ST7789V display on Zephyr.
 */
class GFX : public Adafruit_GFX {

public:
  GFX(struct device* display_dev, int16_t w, int16_t h); // Constructor

  // This MUST be defined by the subclass:
  void drawPixel(
      int16_t x, int16_t y,
      uint16_t color); ///< Virtual drawPixel() function to draw to the
                           ///< screen/framebuffer/etc, must be overridden in
                           ///< subclass. @param x X coordinate.  @param y Y
                           ///< coordinate. @param color 16-bit pixel color.
  virtual void startWrite(void);
  virtual void writePixel(int16_t x, int16_t y, uint16_t color);
  virtual void writeFillRect(int16_t x, int16_t y, int16_t w, int16_t h,
                             uint16_t color);
  virtual void writeFastVLine(int16_t x, int16_t y, int16_t h, uint16_t color);
  virtual void writeFastHLine(int16_t x, int16_t y, int16_t w, uint16_t color);
  virtual void endWrite(void);

  void openBuffer(int16_t x, int16_t y, int16_t w, int16_t h);
  void flushBuffer();

private:
	struct device *display_dev;
	struct display_buffer_descriptor pixelBufferDesc;
        
	u8_t *buffer;
	int16_t bx, by, bw, bh;
};

/**
 * GFX Factory
 */
GFX* createGFX(struct device* display_dev);
```

## src/backlight.c
```c
#include <zephyr.h>
#include <device.h>
#include <drivers/gpio.h>
#include "backlight.h"

#define LED_PORT        DT_ALIAS_LED1_GPIOS_CONTROLLER
#define LED             DT_ALIAS_LED1_GPIOS_PIN

struct device* backlight_dev;

void backlight_enable(bool enable) {
	gpio_pin_write(backlight_dev, LED, enable ? 0 : 1);
}

void backlight_init(void)
{
    printk("Backlight starting...");
	backlight_dev = device_get_binding(LED_PORT);
	gpio_pin_configure(backlight_dev, LED, GPIO_DIR_OUT);
	backlight_enable(true);
	printk("Backlight inited.\n");
}
```

## src/backlight.h
```c
void backlight_enable(bool enable);
void backlight_init(void);
```

## src/bt.c
```c
/*
 * Copyright (c) 2015-2016 Intel Corporation
 *
 * SPDX-License-Identifier: Apache-2.0
 */

#include <zephyr/types.h>
#include <stddef.h>
#include <string.h>
#include <errno.h>
#include <sys/printk.h>
#include <sys/byteorder.h>
#include <zephyr.h>

#include <settings/settings.h>

#include <bluetooth/bluetooth.h>
#include <bluetooth/hci.h>
#include <bluetooth/conn.h>
#include <bluetooth/uuid.h>
#include <bluetooth/gatt.h>
#include <bluetooth/services/bas.h>
#include <bluetooth/services/hrs.h>

#include "log.h"
#include "bt.h"
#include "cts.h"

static uint8_t bt_connection_status = BT_STATUS_DISCONNECTED;

static bool advertising = false;
#define ADVERTISING_TIMEOUT 10
static u16_t advertising_timeout = ADVERTISING_TIMEOUT;

static const struct bt_data ad[] = {
	BT_DATA_BYTES(BT_DATA_FLAGS, (BT_LE_AD_GENERAL | BT_LE_AD_NO_BREDR)),
	BT_DATA_BYTES(BT_DATA_UUID16_ALL,
		      0x0d, 0x18, 0x0f, 0x18, 0x05, 0x18),
	BT_DATA_BYTES(BT_DATA_UUID128_ALL,
		      0xf0, 0xde, 0xbc, 0x9a, 0x78, 0x56, 0x34, 0x12,
		      0x78, 0x56, 0x34, 0x12, 0x78, 0x56, 0x34, 0x12),
};

static void connected(struct bt_conn *conn, u8_t err)
{
	if (err) {
		LOG_WRN("BT Connection failed (err 0x%02x).", err);
	} else {
		LOG_INF("BT Connected.");
		bt_connection_status = BT_STATUS_CONNECTED;
	}
}

static void disconnected(struct bt_conn *conn, u8_t reason)
{
	LOG_INF("BT Disconnected (reason 0x%02x).", reason);
	bt_connection_status = BT_STATUS_DISCONNECTED;
}

static struct bt_conn_cb conn_callbacks = {
	.connected = connected,
	.disconnected = disconnected,
};

static void bt_advertising_stop()
{
	if (!advertising) {
		return;
	}

	int err = bt_le_adv_stop();
	if (err) {
		LOG_ERR("Bluetooth advertising failed to stop (err %d).", err);
		advertising = true;
		return;
	}
	advertising = false;
	advertising_timeout = ADVERTISING_TIMEOUT;
	LOG_INF("Bluetooth advertising successfully stopped.");
}

static void bt_advertising_start()
{
	if (advertising) {
		return;
	}

	int err = bt_le_adv_start(BT_LE_ADV_CONN_NAME, ad, ARRAY_SIZE(ad), NULL, 0);
	if (err) {
		LOG_ERR("Bluetooth advertising failed to start (err %d).", err);
		advertising = false;
		advertising_timeout = ADVERTISING_TIMEOUT;
		return;
	}
	advertising = true;
	LOG_INF("Bluetooth advertising successfully started.");
}

static void bt_ready(void)
{
	if (IS_ENABLED(CONFIG_SETTINGS)) {
		LOG_INF("Settings loading.");
		settings_load();
	} else {
		LOG_INF("Settings not enabled");
	}

	cts_init();

	bt_advertising_start();
}

static void auth_passkey_display(struct bt_conn *conn, unsigned int passkey)
{
	char addr[BT_ADDR_LE_STR_LEN];

	bt_addr_le_to_str(bt_conn_get_dst(conn), addr, sizeof(addr));

	LOG_INF("Passkey for %s: %06u\n", addr, passkey);
}

static void auth_cancel(struct bt_conn *conn)
{
	char addr[BT_ADDR_LE_STR_LEN];

	bt_addr_le_to_str(bt_conn_get_dst(conn), addr, sizeof(addr));

	LOG_INF("Pairing cancelled: %s\n", addr);
}

static struct bt_conn_auth_cb auth_cb_display = {
	.passkey_display = auth_passkey_display,
	.passkey_entry = NULL,
	.cancel = auth_cancel,
};

static void bas_notify(void)
{
	u8_t battery_level = bt_gatt_bas_get_battery_level();

	battery_level--;

	if (!battery_level) {
		battery_level = 100U;
	}

	bt_gatt_bas_set_battery_level(battery_level);
}

static void hrs_notify(void)
{
	static u8_t heartrate = 90U;

	/* Heartrate measurements simulation */
	heartrate++;
	if (heartrate == 160U) {
		heartrate = 90U;
	}

	bt_gatt_hrs_notify(heartrate);
}

void bt_setup(void)
{
	int err;

	err = bt_enable(NULL);
	if (err) {
		LOG_ERR("Bluetooth init failed (err %d)\n", err);
		return;
	}

	bt_ready();

	bt_conn_cb_register(&conn_callbacks);
	bt_conn_auth_cb_register(&auth_cb_display);

	LOG_INF("Bluetooth inited.");
}

void bt_loop()
{
	/* Implement notification. At the moment there is no suitable way
	 * of starting delayed work so we do it here
	 */

	/* Current Time Service updates only when time is changed */
	cts_notify();

	/* Heartrate measurements simulation */
	hrs_notify();

	/* Battery level simulation */
	bas_notify();

	if (!advertising) {
		if (advertising_timeout <= 0) {
			bt_advertising_start();
			advertising_timeout = ADVERTISING_TIMEOUT;
		} else {
			advertising_timeout--;
		}
	}
}

uint8_t bt_get_connection_status()
{
	return bt_connection_status;
}
```

## src/bt.h
```c
/*
 * Copyright (c) 2015-2016 Intel Corporation
 *
 * SPDX-License-Identifier: Apache-2.0
 */

#include <zephyr/types.h>
#include <stddef.h>
#include <string.h>
#include <errno.h>
#include <sys/printk.h>
#include <sys/byteorder.h>
#include <zephyr.h>

#include <settings/settings.h>

#include <bluetooth/bluetooth.h>
#include <bluetooth/hci.h>
#include <bluetooth/conn.h>
#include <bluetooth/uuid.h>
#include <bluetooth/gatt.h>
#include <bluetooth/services/bas.h>
#include <bluetooth/services/hrs.h>

#include "cts.h"

void bt_setup(void);
void bt_loop();
```

## src/bt_connect.c
```c
#include <zephyr.h>
#include <zephyr/types.h>
#include <stddef.h>
#include <errno.h>
#include <zephyr.h>

#include <bluetooth/bluetooth.h>
#include <bluetooth/hci.h>
#include <bluetooth/conn.h>
#include <bluetooth/uuid.h>
#include <bluetooth/gatt.h>
#include <sys/byteorder.h>

#include "log.h"
#include "bt.h"
#include "bt_connect.h"

bt_addr_le_t last_connected_addr;

#define CONNECT_KNOWN_DEVICE
#ifdef CONNECT_KNOWN_DEVICE
u16_t connect_timeout = 10;
#define CONNECT_TIMEOUT 10;
#endif // CONNECT_KNOWN_DEVICE


//#define SCAN_KNOWN_DEVICES
#ifdef SCAN_KNOWN_DEVICES
bool scanning = false;
u16_t scan_timeout = 10;
#define SCAN_TIMEOUT 30;

static bool is_known_addr(bt_addr_le_t* addr)
{
    return memcmp(&last_connected_addr, addr, sizeof(bt_addr_le_t)) == 0;
}

static void device_found(const bt_addr_le_t *addr, s8_t rssi, u8_t type,
			 struct net_buf_simple *ad)
{
	char dev[BT_ADDR_LE_STR_LEN];

	bt_addr_le_to_str(addr, dev, sizeof(dev));
	LOG_INF("[DEVICE]: %s, AD evt type %u, AD data len %u, RSSI %i\n",
	       log_strdup(dev), type, ad->len, rssi);

    if (is_known_addr(addr)) {
        LOG_INF("Found known device %s, connecting...", log_strdup(dev));
        scanning = false;
        scan_timeout = SCAN_TIMEOUT;
        int err = bt_le_scan_stop();
        if (err) {
            LOG_ERR("Stop LE scan failed (err %d)\n", err);
            return;
        }

        bt_conn_create_le(addr, BT_LE_CONN_PARAM_DEFAULT);
    }
}

static int scan_start(void)
{
	struct bt_le_scan_param scan_param = {
		.type       = BT_HCI_LE_SCAN_ACTIVE,
		.filter_dup = BT_HCI_LE_SCAN_FILTER_DUP_DISABLE,
		.interval   = BT_GAP_SCAN_FAST_INTERVAL,
		.window     = BT_GAP_SCAN_FAST_WINDOW,
	};

	return bt_le_scan_start(&scan_param, device_found);
}
#endif // SCAN_KNOWN_DEVICES

static void connected(struct bt_conn *conn, u8_t conn_err)
{
	if (conn_err) {
		return;
	}

#ifdef SCAN_KNOWN_DEVICES
    int err = bt_le_scan_stop();
    if (err) {
        LOG_ERR("Stop LE scan failed (err %d)\n", err);
    }
    scanning = false;
    scan_timeout = SCAN_TIMEOUT;
#endif

#ifdef CONNECT_KNOWN_DEVICE
    connect_timeout = CONNECT_TIMEOUT;
#endif // CONNECT_KNOWN_DEVICE

    bt_addr_le_t* addr = bt_conn_get_dst(conn);
    memcpy(&last_connected_addr, addr, sizeof(bt_addr_le_t));

    char dev[BT_ADDR_LE_STR_LEN];
	bt_addr_le_to_str(addr, dev, sizeof(dev));
    LOG_INF("Connected to %s, marking as a known device.", log_strdup(dev));
}

static void disconnected(struct bt_conn *conn, u8_t reason)
{
#ifdef SCAN_KNOWN_DEVICES
	int err = scan_start();
	if (err) {
        scanning = false;
        scan_timeout = SCAN_TIMEOUT;
		LOG_ERR("Scanning failed to start (err %d)\n", err);
        return;
	}
    scanning = true;
#endif

#ifdef CONNECT_KNOWN_DEVICE
    connect_timeout = CONNECT_TIMEOUT;
#endif // CONNECT_KNOWN_DEVICE
}

static struct bt_conn_cb conn_callbacks = {
	.connected = connected,
	.disconnected = disconnected,
};


void bt_connect_init()
{
    bt_conn_cb_register(&conn_callbacks);
}

void bt_connect_loop()
{
#ifdef SCAN_KNOWN_DEVICES
    if (!scanning) {
        if (scan_timeout <= 0) {
            scan_start();
        } else {
            scan_timeout--;
        }
    }
#endif // SCAN_KNOWN_DEVICES

#ifdef CONNECT_KNOWN_DEVICE
    if (bt_get_connection_status() == BT_STATUS_DISCONNECTED) {
        if (connect_timeout <= 0) {
            bt_conn_create_slave_le(&last_connected_addr, BT_LE_ADV_CONN_DIR_LOW_DUTY);
            connect_timeout = CONNECT_TIMEOUT;
            LOG_INF("Trying to connect to last known master...");
        } else {
            connect_timeout--;
        }
    }
#endif // CONNECT_KNOWN_DEVICE
}
```

## src/bt_connect.h
```c
void bt_connect_init();
void bt_connect_loop();
```

## src/bt_notify_service.c
```c
#include <zephyr.h>
#include <zephyr/types.h>
#include <stddef.h>
#include <string.h>
#include <errno.h>
#include <sys/byteorder.h>

#include <settings/settings.h>

#include <bluetooth/bluetooth.h>
#include <bluetooth/hci.h>
#include <bluetooth/conn.h>
#include <bluetooth/uuid.h>
#include <bluetooth/gatt.h>
#include <bluetooth/services/bas.h>
#include <bluetooth/services/hrs.h>

#include "log.h"
#include "bt.h"

/* Custom Service Variables */
static struct bt_uuid_128 vnd_uuid = BT_UUID_INIT_128(
	0xf0, 0xde, 0xbc, 0x9a, 0x78, 0x56, 0x34, 0x12,
	0x78, 0x56, 0x34, 0x12, 0x78, 0x56, 0x34, 0x12);

static struct bt_uuid_128 vnd_enc_uuid = BT_UUID_INIT_128(
	0xf1, 0xde, 0xbc, 0x9a, 0x78, 0x56, 0x34, 0x12,
	0x78, 0x56, 0x34, 0x12, 0x78, 0x56, 0x34, 0x12);

static struct bt_uuid_128 vnd_auth_uuid = BT_UUID_INIT_128(
	0xf2, 0xde, 0xbc, 0x9a, 0x78, 0x56, 0x34, 0x12,
	0x78, 0x56, 0x34, 0x12, 0x78, 0x56, 0x34, 0x12);

static u8_t vnd_value[] = { 'V', 'e', 'n', 'd', 'o', 'r' };

static ssize_t read_vnd(struct bt_conn *conn, const struct bt_gatt_attr *attr,
			void *buf, u16_t len, u16_t offset)
{
	char *value = attr->user_data;

	return bt_gatt_attr_read(conn, attr, buf, len, offset, value,
				 strlen(value));
}

static ssize_t write_vnd(struct bt_conn *conn, const struct bt_gatt_attr *attr,
			 const void *buf, u16_t len, u16_t offset,
			 u8_t flags)
{
	u8_t *value = attr->user_data;

	if (offset + len > sizeof(vnd_value)) {
		return BT_GATT_ERR(BT_ATT_ERR_INVALID_OFFSET);
	}

	memcpy(value + offset, buf, len);

	return len;
}

static u8_t simulate_vnd;
static u8_t indicating;
static struct bt_gatt_indicate_params ind_params;

static void vnd_ccc_cfg_changed(const struct bt_gatt_attr *attr, u16_t value)
{
	simulate_vnd = (value == BT_GATT_CCC_INDICATE) ? 1 : 0;
}

static void indicate_cb(struct bt_conn *conn, const struct bt_gatt_attr *attr,
			u8_t err)
{
	printk("Indication %s\n", err != 0U ? "fail" : "success");
	indicating = 0U;
}

#define MAX_DATA 74
static u8_t vnd_long_value[] = {
		  'V', 'e', 'n', 'd', 'o', 'r', ' ', 'd', 'a', 't', 'a', '1',
		  'V', 'e', 'n', 'd', 'o', 'r', ' ', 'd', 'a', 't', 'a', '2',
		  'V', 'e', 'n', 'd', 'o', 'r', ' ', 'd', 'a', 't', 'a', '3',
		  'V', 'e', 'n', 'd', 'o', 'r', ' ', 'd', 'a', 't', 'a', '4',
		  'V', 'e', 'n', 'd', 'o', 'r', ' ', 'd', 'a', 't', 'a', '5',
		  'V', 'e', 'n', 'd', 'o', 'r', ' ', 'd', 'a', 't', 'a', '6',
		  '.', ' ' };

static ssize_t read_long_vnd(struct bt_conn *conn,
			     const struct bt_gatt_attr *attr, void *buf,
			     u16_t len, u16_t offset)
{
	const char *value = attr->user_data;

	return bt_gatt_attr_read(conn, attr, buf, len, offset, value,
				 sizeof(vnd_long_value));
}

static ssize_t write_long_vnd(struct bt_conn *conn,
			      const struct bt_gatt_attr *attr, const void *buf,
			      u16_t len, u16_t offset, u8_t flags)
{
	u8_t *value = attr->user_data;

	if (flags & BT_GATT_WRITE_FLAG_PREPARE) {
		return 0;
	}

	if (offset + len > sizeof(vnd_long_value)) {
		return BT_GATT_ERR(BT_ATT_ERR_INVALID_OFFSET);
	}

	memcpy(value + offset, buf, len);

	return len;
}

static const struct bt_uuid_128 vnd_long_uuid = BT_UUID_INIT_128(
	0xf3, 0xde, 0xbc, 0x9a, 0x78, 0x56, 0x34, 0x12,
	0x78, 0x56, 0x34, 0x12, 0x78, 0x56, 0x34, 0x12);

static struct bt_gatt_cep vnd_long_cep = {
	.properties = BT_GATT_CEP_RELIABLE_WRITE,
};

static int signed_value;

static ssize_t read_signed(struct bt_conn *conn, const struct bt_gatt_attr *attr,
			   void *buf, u16_t len, u16_t offset)
{
	const char *value = attr->user_data;

	return bt_gatt_attr_read(conn, attr, buf, len, offset, value,
				 sizeof(signed_value));
}

static ssize_t write_signed(struct bt_conn *conn, const struct bt_gatt_attr *attr,
			    const void *buf, u16_t len, u16_t offset,
			    u8_t flags)
{
	u8_t *value = attr->user_data;

	if (offset + len > sizeof(signed_value)) {
		return BT_GATT_ERR(BT_ATT_ERR_INVALID_OFFSET);
	}

	memcpy(value + offset, buf, len);

	return len;
}

static const struct bt_uuid_128 vnd_signed_uuid = BT_UUID_INIT_128(
	0xf3, 0xde, 0xbc, 0x9a, 0x78, 0x56, 0x34, 0x13,
	0x78, 0x56, 0x34, 0x12, 0x78, 0x56, 0x34, 0x13);

static const struct bt_uuid_128 vnd_write_cmd_uuid = BT_UUID_INIT_128(
	0xf4, 0xde, 0xbc, 0x9a, 0x78, 0x56, 0x34, 0x12,
	0x78, 0x56, 0x34, 0x12, 0x78, 0x56, 0x34, 0x12);

static ssize_t write_without_rsp_vnd(struct bt_conn *conn,
				     const struct bt_gatt_attr *attr,
				     const void *buf, u16_t len, u16_t offset,
				     u8_t flags)
{
	u8_t *value = attr->user_data;

	/* Write request received. Reject it since this char only accepts
	 * Write Commands.
	 */
	if (!(flags & BT_GATT_WRITE_FLAG_CMD)) {
		return BT_GATT_ERR(BT_ATT_ERR_WRITE_REQ_REJECTED);
	}

	if (offset + len > sizeof(vnd_value)) {
		return BT_GATT_ERR(BT_ATT_ERR_INVALID_OFFSET);
	}

	memcpy(value + offset, buf, len);

	return len;
}

/* Vendor Primary Service Declaration */
BT_GATT_SERVICE_DEFINE(vnd_svc,
	BT_GATT_PRIMARY_SERVICE(&vnd_uuid),
	BT_GATT_CHARACTERISTIC(&vnd_enc_uuid.uuid,
			       BT_GATT_CHRC_READ | BT_GATT_CHRC_WRITE |
			       BT_GATT_CHRC_INDICATE,
			       BT_GATT_PERM_READ_ENCRYPT |
			       BT_GATT_PERM_WRITE_ENCRYPT,
			       read_vnd, write_vnd, vnd_value),
	BT_GATT_CCC(vnd_ccc_cfg_changed,
		    BT_GATT_PERM_READ | BT_GATT_PERM_WRITE_ENCRYPT),
	BT_GATT_CHARACTERISTIC(&vnd_auth_uuid.uuid,
			       BT_GATT_CHRC_READ | BT_GATT_CHRC_WRITE,
			       BT_GATT_PERM_READ_AUTHEN |
			       BT_GATT_PERM_WRITE_AUTHEN,
			       read_vnd, write_vnd, vnd_value),
	BT_GATT_CHARACTERISTIC(&vnd_long_uuid.uuid, BT_GATT_CHRC_READ |
			       BT_GATT_CHRC_WRITE | BT_GATT_CHRC_EXT_PROP,
			       BT_GATT_PERM_READ | BT_GATT_PERM_WRITE |
			       BT_GATT_PERM_PREPARE_WRITE,
			       read_long_vnd, write_long_vnd, &vnd_long_value),
	BT_GATT_CEP(&vnd_long_cep),
	BT_GATT_CHARACTERISTIC(&vnd_signed_uuid.uuid, BT_GATT_CHRC_READ |
			       BT_GATT_CHRC_WRITE | BT_GATT_CHRC_AUTH,
			       BT_GATT_PERM_READ | BT_GATT_PERM_WRITE,
			       read_signed, write_signed, &signed_value),
	BT_GATT_CHARACTERISTIC(&vnd_write_cmd_uuid.uuid,
			       BT_GATT_CHRC_WRITE_WITHOUT_RESP,
			       BT_GATT_PERM_WRITE, NULL,
			       write_without_rsp_vnd, &vnd_value),
);

void bt_notify_service_init()
{

}

void bt_notify_service_loop()
{
    /* Vendor indication simulation */
	if (simulate_vnd) {
		if (indicating) {
			return;
		}

		ind_params.attr = &vnd_svc.attrs[2];
		ind_params.func = indicate_cb;
		ind_params.data = &indicating;
		ind_params.len = sizeof(indicating);

		if (bt_gatt_indicate(NULL, &ind_params) == 0) {
			indicating = 1U;
		}
	}

}
```

## src/button.c
```c
#include <zephyr.h>
#include <device.h>
#include <drivers/gpio.h>
#include "backlight.h"
#include "button.h"

/* change this to use another GPIO port */
#ifndef DT_ALIAS_SW0_GPIOS_CONTROLLER
#ifdef SW0_GPIO_NAME
#define DT_ALIAS_SW0_GPIOS_CONTROLLER SW0_GPIO_NAME
#else
#error SW0_GPIO_NAME or DT_ALIAS_SW0_GPIOS_CONTROLLER needs to be set in board.h
#endif
#endif
#define PORT	DT_ALIAS_SW0_GPIOS_CONTROLLER

/* change this to use another GPIO pin */
#ifdef DT_ALIAS_SW0_GPIOS_PIN
#define PIN     DT_ALIAS_SW0_GPIOS_PIN
#else
#error DT_ALIAS_SW0_GPIOS_PIN needs to be set in board.h
#endif

#define EDGE    (GPIO_INT_EDGE | GPIO_INT_DOUBLE_EDGE)

/* change this to enable pull-up/pull-down */
#ifndef DT_ALIAS_SW0_GPIOS_FLAGS
#ifdef DT_ALIAS_SW0_GPIOS_PIN_PUD
#define DT_ALIAS_SW0_GPIOS_FLAGS DT_ALIAS_SW0_GPIOS_PIN_PUD
#else
#define DT_ALIAS_SW0_GPIOS_FLAGS 0
#endif
#endif
#define PULL_UP DT_ALIAS_SW0_GPIOS_FLAGS

struct device* button_dev;

bool isButtonPressed() {
	u32_t val = 0U;
	gpio_pin_read(button_dev, PIN, &val);
	return val == 1U;
}

void button_pressed(struct device *gpiob, struct gpio_callback *cb,
		u32_t pins)
{
    // TODO: callback!
	bool b = isButtonPressed();
	printk("Button pressed: %d\n", b);
	backlight_enable(b);
}

static struct gpio_callback gpio_cb;

void button_init()
{
	u32_t button_out = 1U;

	button_dev = device_get_binding(PORT);
	if (!button_dev) {
		printk("error\n");
		return;
	}

	gpio_pin_configure(button_dev, PIN,
			GPIO_DIR_IN | GPIO_INT |  PULL_UP | EDGE);

	gpio_init_callback(&gpio_cb, button_pressed, BIT(PIN));
	gpio_add_callback(button_dev, &gpio_cb);
	gpio_pin_enable_callback(button_dev, PIN);

//port 15 has to be high in order for the button to work
	gpio_pin_configure(button_dev, 15,GPIO_DIR_OUT); //push button out
	gpio_pin_write(button_dev, 15, button_out); //set port high
	printk("Button inited.\n");
}
```

## src/clock.c
```c
#include <stddef.h>
#include <inttypes.h>
#include <time.h>
#include <sys/printk.h>
#include "clock.h"

/**
 * Local time maintained by the watch.
 */
static time_t local_time = 0;

void clock_init()
{
	local_time = 0;
}

void clock_loop()
{
	// TODO: use timer to increment
	local_time++;
}

time_t clock_get_ticks()
{
	return local_time;
}

struct tm* clock_get_datetime()
{
	return localtime(&local_time);
}

void clock_set_datetime(struct tm* datetime)
{
    local_time = mktime(datetime);
    printk("Local clock se to: %02d:%02d:%02d\n",
        datetime->tm_hour, datetime->tm_min, datetime->tm_sec);
}
```

## src/cts.c
```c
/** @file
 *  @brief CTS Service sample
 */

/*
 * Copyright (c) 2016 Intel Corporation
 *
 * SPDX-License-Identifier: Apache-2.0
 */

#include <zephyr/types.h>
#include <stddef.h>
#include <string.h>
#include <errno.h>
#include <sys/printk.h>
#include <sys/byteorder.h>
#include <zephyr.h>

#include <bluetooth/bluetooth.h>
#include <bluetooth/hci.h>
#include <bluetooth/conn.h>
#include <bluetooth/uuid.h>
#include <bluetooth/gatt.h>

#include "cts.h"

static u8_t ct[10];
static u8_t ct_update;

cts_datetime_t cts_datetime;
void cts_get_datetime(cts_datetime_t* datetime)
{
	memcpy(datetime, ct, sizeof(cts_datetime_t));
}

void empty_cb(int val) {}
static cts_write_cb_t cts_write_cb = empty_cb;

void cts_register_write_cb(cts_write_cb_t cb)
{
	cts_write_cb = cb;
}

static void ct_ccc_cfg_changed(const struct bt_gatt_attr *attr, u16_t value)
{
	printk("Bluetooth CCC cfg changed: %04x", value);

	/* TODO: Handle value */
//	if (cts_write_cb != NULL) {
		cts_write_cb(value);
//	}
}

static ssize_t read_ct(struct bt_conn *conn, const struct bt_gatt_attr *attr,
		       void *buf, u16_t len, u16_t offset)
{
	const char *value = attr->user_data;

	return bt_gatt_attr_read(conn, attr, buf, len, offset, value,
				 sizeof(ct));
}

static ssize_t write_ct(struct bt_conn *conn, const struct bt_gatt_attr *attr,
			const void *buf, u16_t len, u16_t offset,
			u8_t flags)
{
	u8_t *value = attr->user_data;

	if (offset + len > sizeof(ct)) {
		return BT_GATT_ERR(BT_ATT_ERR_INVALID_OFFSET);
	}

	memcpy(value + offset, buf, len);
	ct_update = 1U;

	return len;
}

/* Current Time Service Declaration */
BT_GATT_SERVICE_DEFINE(cts_cvs,
	BT_GATT_PRIMARY_SERVICE(BT_UUID_CTS),
	BT_GATT_CHARACTERISTIC(BT_UUID_CTS_CURRENT_TIME, BT_GATT_CHRC_READ |
			       BT_GATT_CHRC_NOTIFY | BT_GATT_CHRC_WRITE,
			       BT_GATT_PERM_READ | BT_GATT_PERM_WRITE,
			       read_ct, write_ct, ct),
	BT_GATT_CCC(ct_ccc_cfg_changed, BT_GATT_PERM_READ | BT_GATT_PERM_WRITE),
);

static void generate_current_time(u8_t *buf)
{
	u16_t year;

	/* 'Exact Time 256' contains 'Day Date Time' which contains
	 * 'Date Time' - characteristic contains fields for:
	 * year, month, day, hours, minutes and seconds.
	 */

	year = sys_cpu_to_le16(2020);
	memcpy(buf,  &year, 2); /* year */
	buf[2] = 1U; /* months starting from 1 */
	buf[3] = 2U; /* day */
	buf[4] = 3U; /* hours */
	buf[5] = 4U; /* minutes */
	buf[6] = 5U; /* seconds */

	/* 'Day of Week' part of 'Day Date Time' */
	buf[7] = 1U; /* day of week starting from 1 */

	/* 'Fractions 256 part of 'Exact Time 256' */
	buf[8] = 0U;

	/* Adjust reason */
	buf[9] = 0U; /* No update, change, etc */
}

void cts_init(void)
{
	/* Simulate current time for Current Time Service */
	generate_current_time(ct);
}

void cts_notify(void)
{	/* Current Time Service updates only when time is changed */
	if (!ct_update) {
		return;
	}

	ct_update = 0U;
	bt_gatt_notify(NULL, &cts_cvs.attrs[1], &ct, sizeof(ct));
	printk("Bluetooth CTS time updated: %01x%01x...", ct[0], ct[1]);
}
```
